## buildroot/wa_armv5_defconfig
```kconfig
# Target: ARMv5TEJ (arm926ej-s), EABI soft-float, glibc
BR2_arm=y
BR2_arm926t=y
BR2_TOOLCHAIN_BUILDROOT_GLIBC=y
BR2_INIT_NONE=y
BR2_SYSTEM_BIN_SH_BUSYBOX=y
# BR2_TARGET_GENERIC_GETTY is not set
BR2_PACKAGE_BUSYBOX_SHOW_OTHERS=y
BR2_PACKAGE_BASH=y
BR2_PACKAGE_HAPROXY=y
BR2_PACKAGE_OPENSSL=y
BR2_PACKAGE_LIBOPENSSL_BIN=y
BR2_PACKAGE_LIBCURL=y
BR2_PACKAGE_LIBCURL_CURL=y
BR2_PACKAGE_JQ=y
BR2_PACKAGE_ONIGURUMA=y
BR2_PACKAGE_ZLIB=y
BR2_ROOTFS_OVERLAY="/home/br/overlay"
BR2_TARGET_ROOTFS_TAR=y
# BR2_TARGET_ROOTFS_EXT2 is not set
```
